## build_check/main/Kconfig.projbuild
```kconfig
# The options a firmware defines for ap2_core (README.md, "Kconfig options").
menu "AirPlay build check"
    config AIRPLAY_HOMEKIT
        bool "HomeKit"
        default y
    config AIRPLAY_HOMEKIT_MANUFACTURER
        string "Manufacturer"
        default "Espressif"
        depends on AIRPLAY_HOMEKIT
    config AIRPLAY_HOMEKIT_SETUP_CODE
        string "HomeKit pair-setup code"
        default "3939"
        depends on AIRPLAY_HOMEKIT
    config ENABLE_AIRPLAY_ARTWORK
        bool "Advertise artwork support"
        default y if AIRPLAY_HOMEKIT
        default n
    config AIRPLAY_LOG_RTSP_REQUESTS
        bool "Log every RTSP request and reply"
        default n
endmenu
```

## components/apple_clock/Kconfig
```kconfig
menu "Apple Clock"
    config AIRPLAY_APPLE_CLOCK_ASYM_US
        int "Path asymmetry correction (us)"
        default 0
        range -2000 2000
        help
            Added to the sender's time from both directions. Two-way PTP
            cannot see a difference between the two directions of the path;
            if a measurement against a HomePod (microphone, oscilloscope)
            shows a constant one, set it here. Positive: this receiver plays
            earlier.
endmenu
```
